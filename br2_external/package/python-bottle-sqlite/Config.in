## br2_external/package/python-bottle-sqlite/Config.in
```kconfig
config BR2_PACKAGE_PYTHON_BOTTLE_SQLITE
	bool "python-bottle-sqlite"
	help
	  SQLite3 integration for Bottle.

	  https://github.com/bottlepy/bottle-sqlite
```

## br2_external/package/x6100-webserver/Config.in
```kconfig
config BR2_PACKAGE_X6100_WEBSERVER
	bool "x6100_webserver"
	select BR2_PACKAGE_PYTHON3
	select BR2_PACKAGE_PYTHON_BOTTLE
	select BR2_PACKAGE_PYTHON3_SQLITE
	select BR2_PACKAGE_PYTHON_BOTTLE_SQLITE
	help
	  X6100 GUI webserver
```
